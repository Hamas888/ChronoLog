## Kconfig
```kconfig
menu "ChronoLog Configuration"

    config CHRONOLOG_MODE
        bool "Enable ChronoLogging"
        default y
        help
            Enable or disable ChronoLog component.

    config CHRONOLOG_THREAD_SAFE
        bool "Enable ChronoLog Thread Safety"
        default y
        help
            Enable or disable thread safety for the ChronoLog component.
    
    config CHRONOLOG_COLOR_ENABLE
         bool "Enable ChronoLog Color Output"
         default y
         help
             Enable or disable colored output for ChronoLog messages.

    config CHRONOLOG_PRO_FEATURES
        bool "Pro Features"
        default n
        help
            Enable or disable Pro features for the ChronoLog component.

    config CHRONOLOG_PLOT_WINDOW
        int "Graph Plotter Window"
        default 64
        help
            Number of samples retained per plot series (ring buffer).

    config CHRONOLOG_PLOT_SERIES
        int "Graph Plotter Series"
        default 4
        help
            Maximum number of named plot series tracked simultaneously.

    config CHRONOLOG_PLOT_ROWS
        int "Graph Plotter Rows"
        default 5
        help
            Chart height (rows) used by plotWindow().

    config CHRONOLOG_REMOTE_ENABLE
        bool "Remote Logging"
        default n
        help
            Enable or disable remote logging capabilities for the ChronoLog component.

    config CHRONOLOG_SINKS_ENABLE
        bool "Log Sinks (file / custom output)"
        default n
        help
            Enable the pluggable log sink interface and built-in sinks
            (desktop rotating file sink, MCU LittleFS sink).

    config CHRONOLOG_MAX_SINKS
        int "Maximum number of registered sinks"
        default 4
        help
            Max sinks in the fixed registry array (MCU). Desktop/ESP use a vector.

    config CHRONOLOG_SINK_FILE_RETENTION_DAYS
        int "File sink retention (days)"
        default 7
        help
            Keep log files for this many days, then overwrite/rotate.

    config CHRONOLOG_SINK_FILE_MAX_BYTES
        int "File sink max bytes (0 = no cap)"
        default 0
        help
            Per-file size cap; on exceed, rotate to backups.

    config CHRONOLOG_SINK_FILE_ROTATIONS
        int "File sink backup rotations"
        default 3
        help
            Number of rotated backup files to keep.

    config CHRONOLOG_SINK_FILE_CONDENSED
        bool "File sink condensed format"
        default y
        help
            Abbreviate levels (|I|), per-module header, thread registry. On by default
            for MCU (small flash); desktop defaults to full-fidelity instead.

    config CHRONOLOG_BUFFER_LEN
        int "ChronoLog Buffer Length"
        default 256
        help
            The length of the buffer used by the ChronoLog component.

    config CHRONOLOG_MAX_THREADS
        int "ChronoLog Maximum Threads"
        default 10
        help
            The maximum number of threads to track for the ChronoLog component.
    config CHRONOLOG_DEFAULT_LEVEL
        int "ChronoLog Default Level"
        range 0 5
        default 5
        help
            Default log level used by ChronoLogger instances where no level is set.
            0=CHRONOLOG_LEVEL_NONE, 1=FATAL, 2=ERROR, 3=WARN, 4=INFO, 5=DEBUG.

    config CHRONOLOG_FALLBACK_TASK_NAME
        string "ChronoLog Fallback Task Name"
        default "MainTask"
        help
            Fallback task name used in log output when an RTOS task/thread name is not available.

endmenu
```
